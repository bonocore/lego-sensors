#include <M5Atom.h>
#include <Arduino.h>
#include <WiFi.h>
#include <PubSubClient.h>

#include "mqttButtonConfiguration.h"




bool isRed;

const char* ssid        = SECRET_SSID;
const char* password    = SECRET_PASSWORD;
const char* mqtt_server = SECRET_MQTT_SERVER;
const int mqtt_port = SECRET_MQTT_PORT;
const char* mqtt_user = SECRET_MQTT_USER;
const char* mqtt_password = SECRET_MQTT_PASSWORD;
const char* mqtt_topic = SECRET_MQTT_TOPIC;


WiFiClient espClient;

PubSubClient client(espClient);

void callback(char* topic, byte* payload, unsigned int length);

const unsigned char image_allRed[77]=
{
/* width  005 */ 0x05,
/* height 005 */ 0x05,
/* Line   000 */ 0x00,0xaa,0x00, 0x00,0xaa,0x00, 0x00,0xaa,0x00, 0x00,0xaa,0x00, 0x00,0xaa,0x00, //
/* Line   001 */ 0x00,0xaa,0x00, 0x00,0xaa,0x00, 0x00,0xaa,0x00, 0x00,0xaa,0x00, 0x00,0xaa,0x00, //
/* Line   002 */ 0x00,0xaa,0x00, 0x00,0xaa,0x00, 0x00,0xaa,0x00, 0x00,0xaa,0x00, 0x00,0xaa,0x00, //
/* Line   003 */ 0x00,0xaa,0x00, 0x00,0xaa,0x00, 0x00,0xaa,0x00, 0x00,0xaa,0x00, 0x00,0xaa,0x00, //
/* Line   004 */ 0x00,0xaa,0x00, 0x00,0xaa,0x00, 0x00,0xaa,0x00, 0x00,0xaa,0x00, 0x00,0xaa,0x00, //
};

const unsigned char image_allGreen[77]=
{
/* width  005 */ 0x05,
/* height 005 */ 0x05,
/* Line   000 */ 0xff,0x00,0x00, 0xff,0x00,0x00, 0xff,0x00,0x00, 0xff,0x00,0x00, 0xff,0x00,0x00, //
/* Line   001 */ 0xff,0x00,0x00, 0xff,0x00,0x00, 0xff,0x00,0x00, 0xff,0x00,0x00, 0xff,0x00,0x00, //
/* Line   002 */ 0xff,0x00,0x00, 0xff,0x00,0x00, 0xff,0x00,0x00, 0xff,0x00,0x00, 0xff,0x00,0x00, //
/* Line   003 */ 0xff,0x00,0x00, 0xff,0x00,0x00, 0xff,0x00,0x00, 0xff,0x00,0x00, 0xff,0x00,0x00, //
/* Line   004 */ 0xff,0x00,0x00, 0xff,0x00,0x00, 0xff,0x00,0x00, 0xff,0x00,0x00, 0xff,0x00,0x00, //
};

const unsigned char image_allYellow[77]=
{
/* width  005 */ 0x05,
/* height 005 */ 0x05,
/* Line   000 */ 0xff,0xff,0x00, 0xff,0xff,0x00, 0xff,0xff,0x00, 0xff,0xff,0x00, 0xff,0xff,0x00, //
/* Line   001 */ 0xff,0xff,0x00, 0xff,0xff,0x00, 0xff,0xff,0x00, 0xff,0xff,0x00, 0xff,0xff,0x00, //
/* Line   002 */ 0xff,0xff,0x00, 0xff,0xff,0x00, 0xff,0xff,0x00, 0xff,0xff,0x00, 0xff,0xff,0x00, //
/* Line   003 */ 0xff,0xff,0x00, 0xff,0xff,0x00, 0xff,0xff,0x00, 0xff,0xff,0x00, 0xff,0xff,0x00, //
/* Line   004 */ 0xff,0xff,0x00, 0xff,0xff,0x00, 0xff,0xff,0x00, 0xff,0xff,0x00, 0xff,0xff,0x00, //
};

const unsigned char image_allOff[77]=
{
/* width  005 */ 0x05,
/* height 005 */ 0x05,
/* Line   000 */ 0x00,0x00,0x00, 0x00,0x00,0x00, 0x00,0x00,0x00, 0x00,0x00,0x00, 0x00,0x00,0x00, //
/* Line   001 */ 0x00,0x00,0x00, 0x00,0x00,0x00, 0x00,0x00,0x00, 0x00,0x00,0x00, 0x00,0x00,0x00, //
/* Line   002 */ 0x00,0x00,0x00, 0x00,0x00,0x00, 0x00,0x00,0x00, 0x00,0x00,0x00, 0x00,0x00,0x00, //
/* Line   003 */ 0x00,0x00,0x00, 0x00,0x00,0x00, 0x00,0x00,0x00, 0x00,0x00,0x00, 0x00,0x00,0x00, //
/* Line   004 */ 0x00,0x00,0x00, 0x00,0x00,0x00, 0x00,0x00,0x00, 0x00,0x00,0x00, 0x00,0x00,0x00, //
};


void setup() {

  Serial.begin(115200);
  Serial.print("\nSetup...\n");
  isRed=false;
  M5.begin(true, false, true);
  M5.dis.displaybuff( (uint8_t *) image_allYellow);
  WiFi.mode(WIFI_STA);  // Set the mode to WiFi station mode.
  WiFi.begin(ssid, password);  // Start Wifi connection.
  Serial.print("\nConnecting Wifi...\n");
  while (WiFi.status() != WL_CONNECTED) {
        delay(500);
        Serial.print(".");
    }
    Serial.println("WiFi connected");
    Serial.println("IP address: ");
    Serial.println(WiFi.localIP());
    M5.dis.displaybuff( (uint8_t *) image_allGreen);
    client.setServer(mqtt_server, mqtt_port);
    client.setCallback(callback);

}

void loop() {

   if((WiFi.status() == WL_CONNECTED))
   {
     if (!client.connected()) {
        reConnect();
     }
     client.loop();

      if (M5.Btn.wasPressed())
      {
        Serial.print("\nButton pressed\n");
            if(isRed)
            {
                M5.dis.displaybuff( (uint8_t *) image_allGreen);
                isRed=false;
            }else
            {
                M5.dis.displaybuff( (uint8_t *) image_allRed);
                isRed=true;
            }

      }
  }
  else{
        Serial.print("connect failed \n");
        M5.dis.displaybuff( (uint8_t *) image_allYellow);
        M5.update();
      }

  M5.update();
}

void callback(char* topic, byte* payload, unsigned int length) {
    Serial.print("Message arrived [");
    Serial.print(topic);
    Serial.print("] ");
    for (int i = 0; i < length; i++) {
        Serial.print((char)payload[i]);
    }
    if (!strncmp((char *)payload, "open", length)) {
             M5.dis.displaybuff( (uint8_t *) image_allRed);
             isRed=true;
        } else if (!strncmp((char *)payload, "close", length)) {
              M5.dis.displaybuff( (uint8_t *) image_allGreen);
              isRed=false;
        }
    Serial.println();
}

void reConnect() {
    while (!client.connected()) {
        Serial.print("Attempting MQTT connection...");
        // Create a random client ID
        String clientId = "M5Stack-";
        clientId += String(random(0xffff), HEX);
        // Attempt to connect
        if (client.connect(clientId.c_str(),mqtt_user,mqtt_password)) {
            Serial.println("connected");
            // Once connected, publish an announcement to the topic.
            client.publish(mqtt_topic, "hello world");
            // ... and resubscribe
            client.subscribe(mqtt_topic);
        } else {
            Serial.print("failed, rc=");
            Serial.print(client.state());
            Serial.println("try again in 5 seconds");
            delay(5000);
        }
    }
}
